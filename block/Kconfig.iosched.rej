## block/Kconfig.iosched.rej
```kconfig
--- block/Kconfig.iosched
+++ block/Kconfig.iosched
@@ -59,6 +69,16 @@
        config DEFAULT_DEADLINE
                bool "Deadline" if IOSCHED_DEADLINE=y
 
+       config DEFAULT_ROW
+               bool "ROW" if IOSCHED_ROW=y
+               help
+                 The ROW I/O scheduler gives priority to READ requests
+                 over the WRITE requests when dispatching, without starving
+                 WRITE requests. Requests are kept in priority queues.
+                 Dispatching is done in a RR manner when the dispatch quantum
+                 for each queue is defined according to queue priority.
+                 Most suitable for mobile devices.
+
        config DEFAULT_CFQ
                bool "CFQ" if IOSCHED_CFQ=y
 
@@ -70,6 +90,7 @@
 config DEFAULT_IOSCHED
        string
        default "deadline" if DEFAULT_DEADLINE
+       default "row" if DEFAULT_ROW
        default "cfq" if DEFAULT_CFQ
        default "noop" if DEFAULT_NOOP
 
```
